/*@!Encoding:1252*/
includes
{
  
}

variables
{
  message KlemmenStatus_01 KlemmenStatus;
  msTimer t_KlemmenStatus;
  int s_KeyPosition = 0;  
  int Error = 0;
  
}

on start {
  KlemmenStatus.KL_S = 0;
  KlemmenStatus.KL_15 = 0;
  KlemmenStatus.KL_50 = 0;
  setTimerCyclic(t_KlemmenStatus, 100);
}

on timer t_KlemmenStatus{
  output(KlemmenStatus);  
}

on message SecurityStatus_01 {    // Key_Status
  @env_KeyPosition = this.KeyPosition;
  switch (this.KeyPosition){
    case 0:
      @env_Key_Out = 1;
      @env_Key_Near = 0;
      @env_Key_In = 0;
      break;
    case 1:
      @env_Key_Out = 0;
      @env_Key_Near = 1;
      @env_Key_In = 0;
      break;
    case 2:
      @env_Key_Out = 0;
      @env_Key_Near = 0;
      @env_Key_In = 1;
      @env_System_Status = 0;
      break;
  }
  
  if(this.KeyPosition == 0 && @env_MotorState == 1){ 
    @env_System_Status = 1;
    @env_MotorState = 0;
    
    @env_GearBoxPosition = 1;
    @env_PositionGB_Unknown = 0;
    @env_PositionGB_P = 1;
    @env_PositionGB_N = 0;
    @env_PositionGB_D = 0;
    @env_PositionGB_S = 0;
    @env_PositionGB_R = 0;
    @env_PositionGB_Error = 0;
    
    @env_KL_Status = 0;
    @env_KLS = 0;
    @env_KL15 = 0;
    @env_KL50 = 0;
  }
}

on message Smls_01{         // KL_Status
  
  switch (@env_KL_Status){
  case 0:
    KlemmenStatus.KL_S = 0;
    KlemmenStatus.KL_15 = 0;
    KlemmenStatus.KL_50 = 0;
      
    @env_MotorState = 0;
    break;
  case 1:
    KlemmenStatus.KL_S = 1;
    KlemmenStatus.KL_15 = 0;
    KlemmenStatus.KL_50 = 0;
      
    @env_MotorState = 0;
    break;
  case 2:
    if(@env_KLS == 1 && (@env_Key_In == 1 || @env_Key_Near == 1)){
      KlemmenStatus.KL_S = 1;
      KlemmenStatus.KL_15 = 1;
      KlemmenStatus.KL_50 = 0;
    }
    else {
      if(@env_KLS == 1){
        KlemmenStatus.KL_S = 1;
        KlemmenStatus.KL_15 = 0;
        KlemmenStatus.KL_50 = 0;
        @env_KL_Status = 1;
      } 
      else {
        KlemmenStatus.KL_S = 0;
        KlemmenStatus.KL_15 = 0;
        KlemmenStatus.KL_50 = 0;
        @env_KL_Status = 0;
      }
    }
    break;
  case 3:
    if(@env_GearBoxPosition == 2 && @env_KL15 == 1 && @env_Key_In == 1){
      KlemmenStatus.KL_S = 1;
      KlemmenStatus.KL_15 = 1;
      KlemmenStatus.KL_50 = 1;
    }
    else {
      KlemmenStatus.KL_50 = 0;
      if (@env_KL15 == 1) @env_KL_Status = 2;
      else if(@env_KLS == 1) @env_KL_Status = 1;
      else @env_KL_Status = 0;
    }
    break;
  }
}  
  
on message MotorStatus_01{
  if((this.MotorState == 1) && (KlemmenStatus.KL_50 == 1)){
    write("Motor started");
    KlemmenStatus.KL_50 = 0;
    if (@env_KL_Status == 3) @env_KL_Status = 2;
    @env_KL50 = 0;
  }
}

